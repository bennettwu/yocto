## meta-system/conf/layer.conf
```bitbake
BBPATH .= ":${LAYERDIR}"

# We have a packages directory, add to BBFILES
BBFILES += "${LAYERDIR}/recipes-*/*/*.bb \
            ${LAYERDIR}/recipes-*/*/*.bbappend"

BBFILE_COLLECTIONS += "meta-system"
BBFILE_PATTERN_meta-system := "^${LAYERDIR}/"
BBFILE_PRIORITY_meta-system = "6"
```
